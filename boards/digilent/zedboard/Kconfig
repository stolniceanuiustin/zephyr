## boards/digilent/zedboard/Kconfig
```kconfig
# Copyright (c) 2026 Analog Devices, Inc.
# SPDX-License-Identifier: Apache-2.0

config UART_XLNX_PS
	default y if BOARD_ZEDBOARD
	select PINCTRL if BOARD_ZEDBOARD
```

## boards/digilent/zedboard/Kconfig.defconfig
```kconfig
# Copyright (c) 2026 Analog Devices, Inc.
# SPDX-License-Identifier: Apache-2.0

if BOARD_ZEDBOARD

config UART_XLNX_PS
	default y

config SYS_CLOCK_HW_CYCLES_PER_SEC
	default $(dt_nodelabel_int_prop,arch_timer,clock-frequency)

config NET_TX_STACK_SIZE
	default 8192

config NET_RX_STACK_SIZE
	default 8192

config NET_TCP_WORKQ_STACK_SIZE
	default 8192

config NET_MGMT_EVENT_STACK_SIZE
	default 8192

endif
```

## boards/digilent/zedboard/zedboard_defconfig
```kconfig
# SPDX-License-Identifier: Apache-2.0

# The GTC is always clocked at 1/2 of the CPU frequency (CPU_3x2x)
CONFIG_ARM_ARCH_TIMER=y
CONFIG_SYS_CLOCK_HW_CYCLES_PER_SEC=333333333

CONFIG_SERIAL=y
CONFIG_CONSOLE=y
CONFIG_UART_CONSOLE=y

CONFIG_DCACHE=y
CONFIG_DCACHE_LINE_SIZE=32
CONFIG_CACHE_MANAGEMENT=y

CONFIG_ARMV7_EXCEPTION_STACK_SIZE=8192
CONFIG_ARMV7_FIQ_STACK_SIZE=8192
CONFIG_ARMV7_SVC_STACK_SIZE=8192
CONFIG_ARMV7_SYS_STACK_SIZE=8192
CONFIG_IDLE_STACK_SIZE=8192
CONFIG_ISR_STACK_SIZE=8192
CONFIG_MAIN_STACK_SIZE=8192
CONFIG_SYSTEM_WORKQUEUE_STACK_SIZE=8192
```

## drivers/adc/Kconfig.ad463x
```kconfig
# Copyright (c) 2026 Analog Devices, Inc.
# SPDX-License-Identifier: Apache-2.0

config ADC_AD463X
	bool "Analog Devices AD463x precision SAR ADC"
	default y
	depends on DT_HAS_ADI_AD463X_ENABLED
	depends on SPI_ADI_AXI_SPI_ENGINE
	depends on DMA_ADI_AXI_DMAC
	depends on CLOCK_CONTROL_ADI_AXI_CLKGEN
	depends on PWM_ADI_AXI_PWMGEN
	help
	  Driver for the Analog Devices AD463x family precision SAR ADCs
	  (AD4630-x / AD4631-x / AD4632-x). Operates in offload mode using
	  the AXI SPI Engine, AXI DMAC, AXI CLKGEN, and AXI PWMGEN cores.

if ADC_AD463X

config ADC_AD463X_STREAM_RING_SIZE
	int "Gapless stream ring size in bytes"
	default 524288
	help
	  Cyclic DMA ring behind ad463x_stream_read(). A larger ring tolerates
	  longer reader stalls before samples are dropped.

config ADC_AD463X_STREAM_SLOT_SIZE
	int "Gapless stream slot size in bytes"
	default 32768
	help
	  Granularity at which ad463x_stream_read() picks data up from the
	  ring. Must divide the ring size and be a multiple of 32.

module = ADC_AD463X
module-str = adc_ad463x
source "subsys/logging/Kconfig.template.log_config"

endif
```

## drivers/eeprom/Kconfig.adi_axi_sysid
```kconfig
# Copyright (c) 2026 Analog Devices, Inc.
# SPDX-License-Identifier: Apache-2.0

config EEPROM_ADI_AXI_SYSID
	bool "Analog Devices AXI System ID ROM (read-only EEPROM)"
	default y
	depends on DT_HAS_ADI_AXI_SYSID_ENABLED
	help
	  Enable the read-only EEPROM driver for the Analog Devices AXI
	  System ID core. The core exposes an FPGA build-information ROM
	  (board / product / git data) that is presented through the
	  standard EEPROM API.
```

## drivers/misc/ad9081/Kconfig
```kconfig
# SPDX-License-Identifier: Apache-2.0

config AD9081
	bool "ADI AD9081/AD9082 MxFE driver"
	depends on HAL_ADI_AD9081
	help
	  Zephyr driver wrapper around ADI's AD9081/AD9082 vendor API.

if AD9081

config AD9081_MXFE_INIT_PRIORITY
	int "AD9081/AD9082 MxFE init priority"
	default 70
	help
	  Initialisation priority of the AD9081 MxFE driver, within POST_KERNEL.

	  Must be above CONFIG_SPI_INIT_PRIORITY (default 50): the chip is
	  SPI-attached, and Zephyr SPI controllers initialise at POST_KERNEL.
	  There is a BUILD_ASSERT in ad9081.c for it.

	  Also above CONFIG_AD9081_JESD204_INIT_PRIORITY: the chip node points
	  at the two link cores with adi,jesd-{tx,rx}-link to read the link
	  geometry from them, and Zephyr treats a phandle as an init dependency
	  whether or not the driver dereferences the device at init (this one
	  does not -- it only reads their DT properties at build time).
	  check_init_priorities.py fails the build otherwise.

	  Nothing more is required, because init() only marks the device ready --
	  the chip is programmed by explicit ad9081_probe() /
	  ad9081_setup_datapath() calls from the bring-up sequence, which run
	  from main() and therefore after every driver here.

endif # AD9081
```

## drivers/misc/ad9144/Kconfig
```kconfig
# Analog Devices AD9144 JESD204B DAC

# SPDX-License-Identifier: Apache-2.0

config AD9144
	bool "ADI AD9144 JESD204B DAC (SPI bring-up)"
	default y
	depends on DT_HAS_ADI_AD9144_ENABLED
	select SPI
	help
	  Enable the Analog Devices AD9144 driver: a 16-bit, quad-channel
	  JESD204B DAC. On the DAQ2 FMC it is the TX converter, clocked by the
	  AD9523-1 (DAC_CLK).

	  This is the standalone SPI bring-up only: it proves the bus by reading
	  the chip ID, soft-resets the chip, applies the ad9144_setup() register
	  sequence and reports the SERDES PLL lock status. It does NOT wire the
	  AXI JESD204 link cores, the transceivers, or the jesd204 FSM -- those
	  are a separate later block, and until they land the lane sync / DAC
	  output is unverified.

if AD9144

config AD9144_INIT_PRIORITY
	int "AD9144 DAC init priority"
	default 70
	help
	  Initialisation priority of the AD9144 driver, within POST_KERNEL.

	  The chip is SPI-attached, so this must be strictly greater than
	  CONFIG_SPI_INIT_PRIORITY (default 50) -- a BUILD_ASSERT in ad9144.c
	  enforces it. It must also be greater than the AD9523 clock generator's
	  init priority (default 60) so the DAC sample clock is running before the
	  DAC is brought up.

endif # AD9144
```

## drivers/misc/ad9680/Kconfig
```kconfig
# Analog Devices AD9680 JESD204B ADC

# SPDX-License-Identifier: Apache-2.0

config AD9680
	bool "ADI AD9680 JESD204B ADC (SPI bring-up)"
	default y
	depends on DT_HAS_ADI_AD9680_ENABLED
	select SPI
	help
	  Enable the Analog Devices AD9680 driver: a 14-bit, dual-channel
	  JESD204B ADC. On the DAQ2 FMC it is the RX converter, clocked by the
	  AD9523-1.

	  This is the standalone SPI bring-up only: it proves the bus by reading
	  the chip ID, soft-resets the chip, applies the JESD204B register
	  configuration and reports the JESD PLL lock status. It does NOT wire the
	  AXI JESD204 link cores, the transceivers, or the jesd204 FSM -- those
	  are a separate later block, and until they land the lane sync / data
	  capture is unverified.

if AD9680

config AD9680_INIT_PRIORITY
	int "AD9680 ADC init priority"
	default 70
	help
	  Initialisation priority of the AD9680 driver, within POST_KERNEL.

	  The chip is SPI-attached, so this must be strictly greater than
	  CONFIG_SPI_INIT_PRIORITY (default 50) -- a BUILD_ASSERT in ad9680.c
	  enforces it. It must also be greater than the AD9523 clock generator's
	  init priority (default 60) so the ADC sample clock is running before the
	  ADC is brought up.

endif # AD9680
```

## drivers/misc/jesd204/Kconfig
```kconfig
# Copyright (c) 2026 Analog Devices, Inc.
# SPDX-License-Identifier: Apache-2.0

menuconfig JESD204
	bool "JESD204 bring-up framework"
	help
	  Enable the generic, board-agnostic JESD204 bring-up state machine
	  that walks every device on a link through the phases DEVICE_INIT
	  to LINK_RUNNING.

if JESD204

module = JESD204
module-str = JESD204
source "subsys/logging/Kconfig.template.log_config"

endif # JESD204

# ADI JESD204 AXI IP cores for FPGA fabric
#
# These are the FPGA-side halves of a JESD204 link: the transceiver wrapper,
# the link (framer/deframer) cores and the transport layer. They are ADI's
# AXI IP, instantiated in the programmable logic, and are independent of
# which converter sits on the other end of the link.
#
# SPDX-License-Identifier: Apache-2.0

menuconfig JESD204_AXI
	bool "ADI JESD204 AXI IP core drivers"
	select JESD204
	help
	  Drivers for ADI's JESD204 AXI IP cores in FPGA fabric.

	  These drivers configure the cores and expose enable/status calls.
	  Sequencing the enables across every device on the link is the
	  caller's job: a JESD204 link only comes up when the converter, the
	  transceiver and the link cores pass through the same phases
	  together. See samples/drivers/misc/ad9081 for a phase-ordered
	  bring-up built on these drivers.

if JESD204_AXI

config JESD204_AXI_ADXCVR
	bool "ADI AXI ADXCVR transceiver wrapper"
	default y
	depends on DT_HAS_ADI_AXI_ADXCVR_1_0_ENABLED
	help
	  ADI's axi_adxcvr wrapper around the FPGA serial transceivers,
	  including the Xilinx GTH/GTY divider and DRP programming needed to
	  hit a given lane rate from a given reference clock.

config JESD204_AXI_ADXCVR_INIT_PRIORITY
	int "AXI-ADXCVR (GT transceiver) init priority"
	depends on JESD204_AXI_ADXCVR
	default 65
	help
	  Initialisation priority of the AXI-ADXCVR driver, within POST_KERNEL.

	  Must be above CONFIG_CLOCK_CONTROL_HMC7044_INIT_PRIORITY: the adxcvr
	  nodes take `clocks = <&hmc7044 12>`, and Zephyr's init-priority
	  validation rejects a device that initialises before a devicetree
	  dependency. There is a BUILD_ASSERT in axi_adxcvr.c for it.

endif # JESD204_AXI
```

## dts/bindings/jesd204/adi,axi-jesd-iio.yaml
```yaml
# Copyright (c) 2026 Analog Devices, Inc.
# SPDX-License-Identifier: Apache-2.0

description: |
  Exposes one direction of an ADI JESD204 datapath as an IIO device, so a libiio
  client can stream converter samples over IIOD.

  This node owns no registers of its own. It pairs a transport core (which holds
  the per-converter datapath controls) with the DMA engine that moves samples
  between that core and memory, and presents the pair as an IIO device.

  Direction is not a property: it is derived from the compatible of the node that
  adi,tpl points at, so it cannot contradict the hardware.

  Example:

      rx_iio: jesd-iio-rx {
              compatible = "adi,axi-jesd-iio";
              io-name = "axi-ad9081-rx-hpc";
              adi,tpl = <&rx_tpl>;
              dmas = <&rx_dmac 0>;
              dma-names = "rx";
              adi,converters-per-device = <8>;
      };

compatible: "adi,axi-jesd-iio"

include: base.yaml

properties:
  io-name:
    type: string
    description: |
      Device name reported to IIOD clients. Falls back to the Zephyr device name
      when unset. Set this to the name the client-side tooling expects, which for
      an AD9081 HPC carrier is axi-ad9081-rx-hpc / axi-ad9081-tx-hpc.

  adi,tpl:
    type: phandle
    required: true
    description: |
      The transport core for this direction: adi,axi-ad9081-rx-1.0 for capture or
      adi,axi-ad9081-tx-1.0 for playback. Supplies the per-converter datapath
      controls the buffer enable toggles, and fixes this node's direction.

  dmas:
    required: true
    description: The DMA channel that moves samples for this direction.

  dma-names:
    required: true
    description: Must be a single entry, "rx" for capture or "tx" for playback.

  adi,converters-per-device:
    type: int
    required: true
    description: |
      Number of converters this IIO device exposes, one IIO channel each. Must
      equal the transport core's adi,num-channels, which the driver asserts at
      build time; both are the link's M.
```

## dts/bindings/misc/adi,ltc4296.yaml
```yaml
description: LTC4296 PSE Controller

compatible: "adi,ltc4296"

include: spi-device.yaml

child-binding:
  description: LTC4296 PSE Controller port properties
  properties:
    sccpo-gpios:
      type: phandle-array
      description: |
        GPIO used to drive the SCCP output signal to the PD.
    sccpi-gpios:
      type: phandle-array
      description: |
        GPIO used to sense the SCCP input signal from the PD.
    adi,power-class:
      type: int
      description: |
        Specifies the SPE's maximum power class.
    adi,hs-resistor:
      type: int
      description: |
        Specifies the SPE's high-side current sense resistor value.
```

## dts/bindings/mtd/adi,axi-sysid.yaml
```yaml
# Copyright (c) 2026 Analog Devices, Inc.
# SPDX-License-Identifier: Apache-2.0

description: |
  Analog Devices AXI System ID core.

  Exposes an FPGA build-information ROM (board / product / git data) through
  the standard read-only EEPROM API. The ROM size is auto-detected from the
  core at init; the "size" property is informational only.

compatible: "adi,axi-sysid"

include: eeprom-base.yaml

properties:
  reg:
    required: true
```

## samples/sensor/6dof_motion_drdy/boards/nucleo_f767zi.conf
```kconfig
#
# Copyright (c) 2026 Analog Devices, Inc.
#
# SPDX-License-Identifier: Apache-2.0
#

CONFIG_SPI=y
CONFIG_GPIO=y
CONFIG_ADIS1647X=y
CONFIG_ADIS1647X_TRIGGER_OWN_THREAD=y
```

## soc/xlnx/zynq7000/Kconfig
```kconfig
#
# Copyright (c) 2021 Weidmueller Interface GmbH & Co. KG
# SPDX-License-Identifier: Apache-2.0
#

if SOC_FAMILY_XILINX_ZYNQ7000

config SOC_XILINX_PL310
	bool "PL310 (L2C-310) outer cache"
	default y
	depends on DCACHE && CACHE_MANAGEMENT
	select OUTER_CACHE
	help
	  Initialize the ARM L2C-310 (PL310) outer-cache controller built into
	  the Zynq-7000 PS at 0xF8F02000 and pair every L1 data-cache
	  maintenance operation with the matching outer-cache operation, so DMA
	  buffers stay coherent across both cache levels.

	  This selects OUTER_CACHE, which makes the Cortex-A/R cache layer call
	  the outer-cache operations implemented by this SoC.

rsource "*/Kconfig"

endif # SOC_FAMILY_XILINX_ZYNQ7000
```

## subsys/jesd204/Kconfig
```kconfig
# JESD204 link bring-up framework
#
# SPDX-License-Identifier: Apache-2.0

config JESD204
	bool "JESD204 link bring-up state machine"
	help
	  Phase-ordered bring-up for JESD204 links, as in the Linux and
	  ADI no-OS jesd204 frameworks. A JESD204 link only comes up when
	  every participating device -- clock generator, converter, FPGA
	  transceiver and FPGA link cores -- passes through the same phases
	  together. Each device registers a table of callbacks indexed by
	  phase, and the framework walks the phases in order rather than the
	  ordering being hand-written per board.

	  Enable this if a board brings up a JESD204 link. Say n if the
	  converters in use stream over something else.
```
