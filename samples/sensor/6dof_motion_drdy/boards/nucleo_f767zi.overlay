/*
 * Copyright (c) 2026 Analog Devices, Inc.
 *
 * SPDX-License-Identifier: Apache-2.0
 */

/ {
	aliases {
		6dof-motion-drdy0 = &adis1647x;
	};
};

&spi1 {
	status = "okay";

	adis1647x: adis1647x@0 {
		compatible = "adi,adis1647x";
		reg = <0>;
		spi-max-frequency = <421875>;
		spi-cpol;
		spi-cpha;
		drdy-gpios = <&gpiof 12 GPIO_ACTIVE_HIGH>;
		reset-gpios = <&gpiod 15 GPIO_ACTIVE_LOW>;
		model = "adis16477-1";
		dec-rate = <99>;
	};
};
